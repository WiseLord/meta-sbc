/dts-v1/;
/plugin/;

/ {
    compatible = "allwinner,sun8i-h3";

    fragment@0 {
        target = <&i2c0>;
        __overlay__ {
            status = "okay";
            #address-cells = <1>;
            #size-cells = <0>;

            gt911@14 {
                compatible = "goodix,gt911";
                reg = <0x14>;

                interrupt-parent = <&pio>;
                interrupts = <0 0 2>; /* PA0, IRQ_TYPE_EDGE_FALLING */

                irq-gpios = <&pio 0 0 0>;    /* PA0 (PIN13) */
                reset-gpios = <&pio 0 1 0>;  /* PA1 (PIN11), ACTIVE_HIGH*/

                /* Native matrix resolution */
                touchscreen-size-x = <320>;
                touchscreen-size-y = <480>;
            };
        };
    };
};

/dts-v1/;
/plugin/;

/ {
    compatible = "allwinner,sun8i-h3";

    fragment@0 {
        target = <&emac>;
        __overlay__ {
            phy-handle = <&int_mii_phy>;
            phy-mode = "mii";
            allwinner,leds-active-low;
            status = "okay";
            local-mac-address = [00 00 00 00 00 00];
        };
    };

    fragment@1 {
        target-path = "/aliases";
        __overlay__ {
            ethernet0 = "/soc/ethernet@1c30000";
        };
    };
};

## meta-sbc/conf/layer.conf
```bitbake
BBPATH .= ":${LAYERDIR}"
BBFILES += "\
            ${LAYERDIR}/recipes-*/*/*.bb \
            ${LAYERDIR}/recipes-*/*/*.bbappend \
           "

BBFILE_COLLECTIONS += "sbc"
BBFILE_PATTERN_sbc := "^${LAYERDIR}/"
BBFILE_PRIORITY_sbc = "20"

LAYERDEPENDS_sbc = "core"
LAYERSERIES_COMPAT_sbc = "wrynose"

DISTRO_FEATURES:remove = "alsa"
DISTRO_FEATURES:remove = "bluetooth"
DISTRO_FEATURES:remove = "debuginfod"
DISTRO_FEATURES:remove = "ipv6"
DISTRO_FEATURES:remove = "zeroconf"
DISTRO_FEATURES:remove = "pci"
DISTRO_FEATURES:remove = "3g"
DISTRO_FEATURES:remove = "nfc"
DISTRO_FEATURES:remove = "x11"
DISTRO_FEATURES:remove = "pulseaudio"
DISTRO_FEATURES:remove = "gobject-introspection-data"
DISTRO_FEATURES:remove = "ptest"
DISTRO_FEATURES:remove = "multiarch"
DISTRO_FEATURES:remove = "wayland"
DISTRO_FEATURES:remove = "vulkan"
```
